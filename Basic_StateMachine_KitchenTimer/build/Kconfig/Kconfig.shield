## Basic_StateMachine_KitchenTimer/build/Kconfig/Kconfig.shield
```kconfig
osource "c:/NRF/Application_1/beacon_2/boards/shields/*/Kconfig.shield"
osource "c:/NRF/Application_1/beacon/boards/shields/*/Kconfig.shield"
osource "C:/NRF/v1.8.0/nrf/boards/shields/*/Kconfig.shield"
```

## Basic_StateMachine_KitchenTimer/build_1/Kconfig/Kconfig.shield.defconfig
```kconfig
osource "c:/NRF/Application_1/beacon_2/boards/shields/*/Kconfig.defconfig"
osource "c:/NRF/Application_1/beacon/boards/shields/*/Kconfig.defconfig"
osource "C:/NRF/v1.8.0/nrf/boards/shields/*/Kconfig.defconfig"
```
